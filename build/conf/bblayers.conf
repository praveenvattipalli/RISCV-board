## build/conf/bblayers.conf
```bitbake
# POKY_BBLAYERS_CONF_VERSION is increased each time build/conf/bblayers.conf
# changes incompatibly
POKY_BBLAYERS_CONF_VERSION = "2"

BBPATH = "${TOPDIR}"
BBFILES ?= ""

BBLAYERS ?= " \
  /home/microchip/riscv/aloelite/yocto_microchip/poky/meta \
  /home/microchip/riscv/aloelite/yocto_microchip/poky/meta-poky \
  /home/microchip/riscv/aloelite/yocto_microchip/poky/meta-yocto-bsp \
  /home/microchip/riscv/aloelite/yocto_microchip/poky/meta-riscv \
  "
```

## meta-riscv/conf/machine/aloelite.conf
```bitbake
#@TYPE: Machine
#@NAME: aloelite
#@SOC: Freedom U540
#@DESCRIPTION: Machine configuration for the Microchip Aloelite development board

require conf/machine/include/riscv/tune-riscv.inc

MACHINE_FEATURES = "screen keyboard ext2 ext3 serial"



KERNEL_IMAGETYPE = "vmlinux"
PREFERRED_PROVIDER_virtual/kernel ?= "linux-riscv"
PREFERRED_VERSION_linux-riscv ?= "4.15%"

EXTRA_IMAGEDEPENDS += "riscv-pk"

PREFERRED_VERSION_openocd-native = "riscv"
PREFERRED_VERSION_openocd = "riscv"


RISCV_BBL_PAYLOAD ?= "${KERNEL_IMAGETYPE}-${MACHINE}.bin"


SERIAL_CONSOLES = "115200;ttySI0"

MACHINE_EXTRA_RRECOMMENDS += " kernel-modules"

IMAGE_FSTYPES += "ext4 tar.gz"

## Do not update fstab file when using wic images
WIC_CREATE_EXTRA_ARGS ?= "--no-fstab-update"

EXTRA_IMAGEDEPENDS += "u-boot"
UBOOT_MACHINE = "HiFive-U540_defconfig"

UBOOT_ENTRYPOINT = "0x80200000"
UBOOT_DTB_LOADADDRESS = "0x82200000"


BAD_RECOMMENDATIONS += "\
    libcxx-dev \
    libcxx-staticdev \
    compiler-rt-dev \
    compiler-rt-staticdev \
"
ASSUME_PROVIDED += "\
    libcxx-dev \
    libcxx-staticdev \
    compiler-rt-dev \
    compiler-rt-staticdev \
"
```
